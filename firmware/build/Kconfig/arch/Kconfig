## firmware/build/Kconfig/arch/Kconfig
```kconfig
# Load Zephyr Arch Kconfig descriptions.
osource "/home/shrutika/zephyrproject/zephyr/arch/x86/Kconfig"
osource "/home/shrutika/zephyrproject/zephyr/arch/xtensa/Kconfig"
osource "/home/shrutika/zephyrproject/zephyr/arch/sparc/Kconfig"
osource "/home/shrutika/zephyrproject/zephyr/arch/riscv/Kconfig"
osource "/home/shrutika/zephyrproject/zephyr/arch/posix/Kconfig"
osource "/home/shrutika/zephyrproject/zephyr/arch/nios2/Kconfig"
osource "/home/shrutika/zephyrproject/zephyr/arch/mips/Kconfig"
osource "/home/shrutika/zephyrproject/zephyr/arch/arm64/Kconfig"
osource "/home/shrutika/zephyrproject/zephyr/arch/arm/Kconfig"
osource "/home/shrutika/zephyrproject/zephyr/arch/arc/Kconfig"
```

## firmware/build/Kconfig/boards/Kconfig
```kconfig
# Load Zephyr board Kconfig descriptions.
osource "/home/shrutika/zephyrproject/zephyr/boards/native/native_sim/Kconfig"
```

## firmware/build/Kconfig/boards/Kconfig.defconfig
```kconfig
# Load Zephyr board defconfig descriptions.
osource "/home/shrutika/zephyrproject/zephyr/boards/native/native_sim/Kconfig.defconfig"
```

## firmware/build/Kconfig/boards/Kconfig.native_sim
```kconfig
# Load board Kconfig descriptions.
osource "/home/shrutika/zephyrproject/zephyr/boards/native/native_sim/Kconfig.native_sim"
```

## firmware/build/Kconfig/boards/Kconfig.sysbuild
```kconfig
# Load Sysbuild board Kconfig descriptions.
osource "/home/shrutika/zephyrproject/zephyr/boards/native/native_sim/Kconfig.sysbuild"
```
